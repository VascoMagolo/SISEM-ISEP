VERSION ""

NS_ :

BS_:

BU_: Turma_2DB Turma_2DA Turma_2DC Test_Node

BO_ 1200 Msg_Group_4: 8 Turma_2DC
 SG_ Temperature : 0|32@1+ (0.1,-55) [-55|6498] "C" Vector__XXX
 SG_ Humidity : 32|32@1+ (0.1,0) [0|100] "%" Vector__XXX

BO_ 1201 Msg_Group_X5: 8 Turma_2DC
 SG_ Temperature : 0|32@1+ (0.1,-55) [-55|6498] "C" Vector__XXX
 SG_ Humidity : 32|32@1+ (0.1,0) [0|100] "%" Vector__XXX

BO_ 1202 Msg_Group_A4: 8 Turma_2DC
 SG_ Temperature : 0|32@1+ (0.1,-55) [-55|6498] "C" Vector__XXX
 SG_ Humidity : 32|32@1+ (0.1,0) [0|100] "%" Vector__XXX

BO_ 1203 Msg_Group_17: 8 Turma_2DC
 SG_ Temperature : 0|32@1+ (0.1,-55) [-55|6498] "C" Vector__XXX
 SG_ Humidity : 32|32@1+ (0.1,0) [0|100] "%" Vector__XXX

BO_ 1204 Msg_Group_B1: 8 Turma_2DC
 SG_ Temperature : 0|32@1+ (0.1,-55) [-55|6498] "C" Vector__XXX
 SG_ Humidity : 32|32@1+ (0.1,0) [0|100] "%" Vector__XXX

BO_ 1205 Msg_Group_X1: 8 Turma_2DA
 SG_ Temperature : 0|32@1+ (0.1,-55) [-55|6498] "C" Vector__XXX
 SG_ Humidity : 32|32@1+ (0.1,0) [0|100] "%" Vector__XXX

BO_ 1206 Msg_Group_7: 8 Turma_2DA
 SG_ Temperature : 0|32@1+ (0.1,-55) [-55|6498] "C" Vector__XXX
 SG_ Humidity : 32|32@1+ (0.1,0) [0|100] "%" Vector__XXX

BO_ 1207 Msg_Group_1: 8 Turma_2DA
 SG_ Temperature : 0|32@1+ (0.1,-55) [-55|6498] "C" Vector__XXX
 SG_ Humidity : 32|32@1+ (0.1,0) [0|100] "%" Vector__XXX

BO_ 1208 Msg_Group_X4: 8 Turma_2DA
 SG_ Temperature : 0|32@1+ (0.1,-55) [-55|6498] "C" Vector__XXX
 SG_ Humidity : 32|32@1+ (0.1,0) [0|100] "%" Vector__XXX

BO_ 1209 Msg_Group_6: 8 Turma_2DA
 SG_ Temperature : 0|32@1+ (0.1,-55) [-55|6498] "C" Vector__XXX
 SG_ Humidity : 32|32@1+ (0.1,0) [0|100] "%" Vector__XXX

BO_ 1210 Msg_Group_8: 8 Turma_2DA
 SG_ Temperature : 0|32@1+ (0.1,-55) [-55|6498] "C" Vector__XXX
 SG_ Humidity : 32|32@1+ (0.1,0) [0|100] "%" Vector__XXX

BO_ 1211 Msg_Group_14: 8 Turma_2DA
 SG_ Temperature : 0|32@1+ (0.1,-55) [-55|6498] "C" Vector__XXX
 SG_ Humidity : 32|32@1+ (0.1,0) [0|100] "%" Vector__XXX

BO_ 1212 Msg_Group_A2: 8 Turma_2DA
 SG_ Temperature : 0|32@1+ (0.1,-55) [-55|6498] "C" Vector__XXX
 SG_ Humidity : 32|32@1+ (0.1,0) [0|100] "%" Vector__XXX

BO_ 1213 Msg_Group_X2: 8 Turma_2DB
 SG_ Temperature : 0|32@1+ (0.1,-55) [-55|6498] "C" Vector__XXX
 SG_ Humidity : 32|32@1+ (0.1,0) [0|100] "%" Vector__XXX

BO_ 1214 Msg_Group_12: 8 Turma_2DB
 SG_ Temperature : 0|32@1+ (0.1,-55) [-55|6498] "C" Vector__XXX
 SG_ Humidity : 32|32@1+ (0.1,0) [0|100] "%" Vector__XXX

BO_ 1215 Msg_Group_18: 8 Turma_2DB
 SG_ Temperature : 0|32@1+ (0.1,-55) [-55|6498] "C" Vector__XXX
 SG_ Humidity : 32|32@1+ (0.1,0) [0|100] "%" Vector__XXX

BO_ 1216 Msg_Group_3: 8 Turma_2DB
 SG_ Temperature : 0|32@1+ (0.1,-55) [-55|6498] "C" Vector__XXX
 SG_ Humidity : 32|32@1+ (0.1,0) [0|100] "%" Vector__XXX

BO_ 1217 Msg_Group_10: 8 Turma_2DB
 SG_ Temperature : 0|32@1+ (0.1,-55) [-55|6498] "C" Vector__XXX
 SG_ Humidity : 32|32@1+ (0.1,0) [0|100] "%" Vector__XXX

BO_ 1218 Msg_Group_X2: 8 Turma_2DB
 SG_ Temperature : 0|32@1+ (0.1,-55) [-55|6498] "C" Vector__XXX
 SG_ Humidity : 32|32@1+ (0.1,0) [0|100] "%" Vector__XXX

BO_ 1219 Msg_Group_5: 8 Turma_2DB
 SG_ Temperature : 0|32@1+ (0.1,-55) [-55|6498] "C" Vector__XXX
 SG_ Humidity : 32|32@1+ (0.1,0) [0|100] "%" Vector__XXX
